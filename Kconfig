## Kconfig.ex1
```kconfig
# Kconfig example 1

mainmenu "Kconfig example 1"

config A
	bool "CONFIG A"
	select B

config B
	bool "CONFIG B"

config C
	bool "CONFIG C"
	select D

config D
	tristate "CONFIG D"

config E
	tristate "CONFIG E"
	select F

config F
	bool "CONFIG F"

config G
	tristate "CONFIG G"
	select H

config H
	tristate "CONFIG H"
	
```

## Kconfig.ex10
```kconfig
menuconfig MODULES
	bool "Enable loadable module support"
	modules
	default y

config A
	bool "A"
	depends on CRAMFS>=MTD

config CRAMFS
	tristate "CRAMFS"

menuconfig MTD
	tristate "MTD"
```

## Kconfig.ex2
```kconfig
# Kconfig example 2

mainmenu "Kconfig example 2 - simple selects"

config A
	bool "CONFIG A"
	default n if B=y || C
	depends on D && F

config B
	bool "CONFIG B"
	default y

config C
	bool "CONFIG C"
	imply B

config D
	bool "CONFIG D"
	select E if A && B || !C

config E
	bool "CONFIG E"
	depends on F

config F
	bool "CONFIG F"
	default y if H!=m
	select C
	select I

config H
	tristate "CONFIG H"

config I
	bool "CONFIG I"
```

## Kconfig.ex3
```kconfig
# Kconfig example 1
mainmenu "Kconfig"

menuconfig MODULES
        bool "Enable loadable module support"
        option modules
        default y

config A
    tristate "Config A"
    #depends on D || (E && F)

config B
    tristate "Config B"
    #depends on C && D && E && F && H


config C
    bool "Config C"
    #depends on C && D && E && F && H

config D
    bool "Config D"
    depends on C || B

config E
    tristate "Config E"

config X
    tristate "Config X"
    #depends on !A
    #depends on C || (A && B && D)
    #depends on (A && B) || (C && D)
    #depends on !A && B!=m
```

## Kconfig.ex4
```kconfig
mainmenu "Kconfig"

menuconfig MODULES
        bool "Enable loadable module support"
        option modules
	default y

config A
	bool "Config A"
	#depends on D || (E && F)
        #select B if H

config B
	tristate "Config B"
	select C

config C
	tristate "Config C"
	#select B
	#depends on A || B

config D
	bool "Config D"
	#select A if !(E && F)
	#depends on (A || B) && C && E
	
config E
	bool "Config E"
	#depends on A && G && C && F

config F
	bool "Config F"
	#depends on C && H

config G
	bool "Config G"

config H
	tristate "Config H"
	depends on I="777"

config I
	int "I"
```

## Kconfig.ex5
```kconfig
mainmenu "Simple example to demo kconfig select broken dependency issue"

menuconfig MODULES
	bool "Enable loadable module support"
	option modules
	default y

config A
	tristate "CONFIG A"

config B
	tristate "CONFIG B"
	depends on A

choice
	prompt "CHOICE_1"
	depends on A && B

config D
	tristate "CONFIG D"

config E
	tristate "CONFIG E"

config F
	tristate "CONFIG F"

config G
	tristate "CONFIG G"

endchoice
```

## Kconfig.ex6
```kconfig
menuconfig MODULES
        bool "Enable loadable module support"
        option modules
	default y

config A
	bool "A prompt"
	#depends on B

config B
	bool "B prompt"

config C
	bool "C prompt"
	#depends on I=5 || I=7

config D
	bool "D prompt"

config I
	int "I"
	depends on C && D
	#default 1
	range 6 10 if A
	range 15 20 if B
	range 25 30

#config H
#	hex "H"
#	range 0x0 0x4
```

## Kconfig.ex7
```kconfig
menuconfig MODULES
	bool "Enable loadable module support"
	option modules
	default y

config A
	tristate "A prompt"

config B
	tristate "B prompt"
	select A if C

config C
	tristate "C prompt"
	

config D
	tristate "D prompt"
	#depends on A	
	#default m if B
	#default C || B

#config E
#	tristate "E prompt" if B
	#depends on A

#if C
#config F
#	bool "F prompt" if B
	#depends on A && B
#endif

#config I
#	int "I prompt"
	#depends on B
	#default 4 if C
#	default 1

#config J
#	int "J prompt"
	#depends on A
#	default 1
```

## Kconfig.ex8
```kconfig
menuconfig MODULES
        bool "Enable loadable module support"
        option modules
	default y

config A
	bool "A"

config B
	tristate "B"
	depends on A

config C
	tristate "C"
	depends on B

config D
	int "D"
	default 0 if B
	default 1

config E
	tristate "E"
	depends on A && B
	default m

config F
	tristate "F"
	depends on C || H
	default y if B
	default m

config G
	tristate "G"
	depends on H
	default y if A
	default m if B

config H
	bool "H"

#config I
#	int "I"
#	default 7

config J
	bool "J"
	default F
```

## Kconfig.ex9
```kconfig
menuconfig MODULES
	bool "Enable loadable module support"
	modules
	default y

config A
	bool "A"

config B
	bool "B"

#config C
#	tristate "C"
#	depends on A && B
#	select E

config D
	bool "D"
#	select E

#config E
#	tristate "E"

config I
	int "I"
	depends on D
	range 5 15

if B
config I
	default 12
endif

if MODULES
choice
	prompt "Module compression mode"
	help
	  This option allows you to choose the algorithm which will be used to
	  compress modules when 'make modules_install' is run. (or, you can
	  choose to not compress modules at all.)

	  External modules will also be compressed in the same way during the
	  installation.

	  For modules inside an initrd or initramfs, it's more efficient to
	  compress the whole initrd or initramfs instead.

	  This is fully compatible with signed modules.

	  Please note that the tool used to load modules needs to support the
	  corresponding algorithm. module-init-tools MAY support gzip, and kmod
	  MAY support gzip, xz and zstd.

	  Your build system needs to provide the appropriate compression tool
	  to compress the modules.

	  If in doubt, select 'None'.

config MODULE_COMPRESS_NONE
	bool "None"
	help
	  Do not compress modules. The installed modules are suffixed
	  with .ko.

config MODULE_COMPRESS_GZIP
	bool "GZIP"
	help
	  Compress modules with GZIP. The installed modules are suffixed
	  with .ko.gz.

config MODULE_COMPRESS_XZ
	bool "XZ"
	help
	  Compress modules with XZ. The installed modules are suffixed
	  with .ko.xz.

config MODULE_COMPRESS_ZSTD
	bool "ZSTD"
	help
	  Compress modules with ZSTD. The installed modules are suffixed
	  with .ko.zst.

endchoice
endif
```

## Kconfig.ex_menu
```kconfig
mainmenu "Example configuration"

menu "Architectures"

menu "Misc"
config EX
	bool "Example option"
endmenu

config X86
	bool "X86 architecture"

config 64BIT
	bool "64 bit support"
	depends on X86

config ARM
	bool "ARM architecture"

endmenu
```

## Kconfig.ex_rangefix
```kconfig
config X1
	bool "x1"

config X2
	bool "x2"
	depends on X3
	depends on X1

config X3
	bool "x3"
	depends on X1
```
